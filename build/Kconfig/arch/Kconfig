## build/Kconfig/arch/Kconfig
```kconfig
# Load arch Kconfig descriptions.
osource "/home/jayesh/zephyrproject/zephyr/arch/x86/Kconfig"
osource "/home/jayesh/zephyrproject/zephyr/arch/xtensa/Kconfig"
osource "/home/jayesh/zephyrproject/zephyr/arch/sparc/Kconfig"
osource "/home/jayesh/zephyrproject/zephyr/arch/riscv/Kconfig"
osource "/home/jayesh/zephyrproject/zephyr/arch/posix/Kconfig"
osource "/home/jayesh/zephyrproject/zephyr/arch/nios2/Kconfig"
osource "/home/jayesh/zephyrproject/zephyr/arch/mips/Kconfig"
osource "/home/jayesh/zephyrproject/zephyr/arch/arm64/Kconfig"
osource "/home/jayesh/zephyrproject/zephyr/arch/arm/Kconfig"
osource "/home/jayesh/zephyrproject/zephyr/arch/arc/Kconfig"
```

## build_1/Kconfig/Kconfig.shield.defconfig
```kconfig
osource "/home/jayesh/zephyrproject/zephyr/samples/basic/blinky_pwm/boards/shields/*/Kconfig.defconfig"
```

## build_1/Kconfig/arch/Kconfig
```kconfig
# Load arch Kconfig descriptions.
osource "/home/leena/zephyrproject/zephyr/arch/x86/Kconfig"
osource "/home/leena/zephyrproject/zephyr/arch/xtensa/Kconfig"
osource "/home/leena/zephyrproject/zephyr/arch/sparc/Kconfig"
osource "/home/leena/zephyrproject/zephyr/arch/riscv/Kconfig"
osource "/home/leena/zephyrproject/zephyr/arch/posix/Kconfig"
osource "/home/leena/zephyrproject/zephyr/arch/nios2/Kconfig"
osource "/home/leena/zephyrproject/zephyr/arch/mips/Kconfig"
osource "/home/leena/zephyrproject/zephyr/arch/arm64/Kconfig"
osource "/home/leena/zephyrproject/zephyr/arch/arm/Kconfig"
osource "/home/leena/zephyrproject/zephyr/arch/arc/Kconfig"
```

## build_1/Kconfig/soc/Kconfig
```kconfig
# Load Zephyr SoC Kconfig descriptions.
osource "/home/leena/zephyrproject/zephyr/soc/xlnx/zynqmp/Kconfig"
osource "/home/leena/zephyrproject/zephyr/soc/xlnx/zynq7000/Kconfig"
osource "/home/leena/zephyrproject/zephyr/soc/xen/Kconfig"
osource "/home/leena/zephyrproject/zephyr/soc/ti/simplelink/Kconfig"
osource "/home/leena/zephyrproject/zephyr/soc/ti/lm3s6965/Kconfig"
osource "/home/leena/zephyrproject/zephyr/soc/ti/k3/Kconfig"
osource "/home/leena/zephyrproject/zephyr/soc/telink/tlsr/Kconfig"
osource "/home/leena/zephyrproject/zephyr/soc/starfive/jh71xx/Kconfig"
osource "/home/leena/zephyrproject/zephyr/soc/st/stm32/Kconfig"
osource "/home/leena/zephyrproject/zephyr/soc/snps/qemu_arc/Kconfig"
osource "/home/leena/zephyrproject/zephyr/soc/snps/nsim/arc_v/Kconfig"
osource "/home/leena/zephyrproject/zephyr/soc/snps/nsim/arc_classic/Kconfig"
osource "/home/leena/zephyrproject/zephyr/soc/snps/hsdk4xd/Kconfig"
osource "/home/leena/zephyrproject/zephyr/soc/snps/hsdk/Kconfig"
osource "/home/leena/zephyrproject/zephyr/soc/snps/emsk/Kconfig"
osource "/home/leena/zephyrproject/zephyr/soc/snps/emsdp/Kconfig"
osource "/home/leena/zephyrproject/zephyr/soc/snps/arc_iot/Kconfig"
osource "/home/leena/zephyrproject/zephyr/soc/silabs/Kconfig"
osource "/home/leena/zephyrproject/zephyr/soc/sifive/sifive_freedom/Kconfig"
osource "/home/leena/zephyrproject/zephyr/soc/sensry/Kconfig"
osource "/home/leena/zephyrproject/zephyr/soc/rockchip/Kconfig"
osource "/home/leena/zephyrproject/zephyr/soc/renode/riscv_virtual/Kconfig"
osource "/home/leena/zephyrproject/zephyr/soc/renesas/smartbond/Kconfig"
osource "/home/leena/zephyrproject/zephyr/soc/renesas/rzt2m/Kconfig"
osource "/home/leena/zephyrproject/zephyr/soc/renesas/rcar/Kconfig"
osource "/home/leena/zephyrproject/zephyr/soc/renesas/ra/Kconfig"
osource "/home/leena/zephyrproject/zephyr/soc/raspberrypi/Kconfig"
osource "/home/leena/zephyrproject/zephyr/soc/quicklogic/eos_s3/Kconfig"
osource "/home/leena/zephyrproject/zephyr/soc/qemu/virt_riscv/Kconfig"
osource "/home/leena/zephyrproject/zephyr/soc/qemu/malta/Kconfig"
osource "/home/leena/zephyrproject/zephyr/soc/openisa/rv32m1/Kconfig"
osource "/home/leena/zephyrproject/zephyr/soc/nxp/s32/Kconfig"
osource "/home/leena/zephyrproject/zephyr/soc/nxp/rw/Kconfig"
osource "/home/leena/zephyrproject/zephyr/soc/nxp/mcx/Kconfig"
osource "/home/leena/zephyrproject/zephyr/soc/nxp/lpc/Kconfig"
osource "/home/leena/zephyrproject/zephyr/soc/nxp/layerscape/Kconfig"
osource "/home/leena/zephyrproject/zephyr/soc/nxp/kinetis/Kconfig"
osource "/home/leena/zephyrproject/zephyr/soc/nxp/imxrt/Kconfig"
osource "/home/leena/zephyrproject/zephyr/soc/nxp/imx/Kconfig"
osource "/home/leena/zephyrproject/zephyr/soc/nuvoton/numicro/Kconfig"
osource "/home/leena/zephyrproject/zephyr/soc/nuvoton/numaker/Kconfig"
osource "/home/leena/zephyrproject/zephyr/soc/nuvoton/npcx/Kconfig"
osource "/home/leena/zephyrproject/zephyr/soc/nuvoton/npcm/Kconfig"
osource "/home/leena/zephyrproject/zephyr/soc/nordic/Kconfig"
osource "/home/leena/zephyrproject/zephyr/soc/neorv32/Kconfig"
osource "/home/leena/zephyrproject/zephyr/soc/native/inf_clock/Kconfig"
osource "/home/leena/zephyrproject/zephyr/soc/microchip/miv/Kconfig"
osource "/home/leena/zephyrproject/zephyr/soc/microchip/mec/Kconfig"
osource "/home/leena/zephyrproject/zephyr/soc/mediatek/mtk_adsp/Kconfig"
osource "/home/leena/zephyrproject/zephyr/soc/lowrisc/opentitan/Kconfig"
osource "/home/leena/zephyrproject/zephyr/soc/litex/litex_vexriscv/Kconfig"
osource "/home/leena/zephyrproject/zephyr/soc/ite/ec/Kconfig"
osource "/home/leena/zephyrproject/zephyr/soc/intel/raptor_lake/Kconfig"
osource "/home/leena/zephyrproject/zephyr/soc/intel/lakemont/Kconfig"
osource "/home/leena/zephyrproject/zephyr/soc/intel/intel_socfpga_std/Kconfig"
osource "/home/leena/zephyrproject/zephyr/soc/intel/intel_socfpga/Kconfig"
osource "/home/leena/zephyrproject/zephyr/soc/intel/intel_niosv/Kconfig"
osource "/home/leena/zephyrproject/zephyr/soc/intel/intel_ish/Kconfig"
osource "/home/leena/zephyrproject/zephyr/soc/intel/intel_adsp/Kconfig"
osource "/home/leena/zephyrproject/zephyr/soc/intel/elkhart_lake/Kconfig"
osource "/home/leena/zephyrproject/zephyr/soc/intel/atom/Kconfig"
osource "/home/leena/zephyrproject/zephyr/soc/intel/apollo_lake/Kconfig"
osource "/home/leena/zephyrproject/zephyr/soc/intel/alder_lake/Kconfig"
osource "/home/leena/zephyrproject/zephyr/soc/infineon/cat3/Kconfig"
osource "/home/leena/zephyrproject/zephyr/soc/infineon/cat1b/Kconfig"
osource "/home/leena/zephyrproject/zephyr/soc/infineon/cat1a/Kconfig"
osource "/home/leena/zephyrproject/zephyr/soc/gd/gd32/Kconfig"
osource "/home/leena/zephyrproject/zephyr/soc/gaisler/leon3/Kconfig"
osource "/home/leena/zephyrproject/zephyr/soc/gaisler/gr716a/Kconfig"
osource "/home/leena/zephyrproject/zephyr/soc/espressif/Kconfig"
osource "/home/leena/zephyrproject/zephyr/soc/ene/kb1200/Kconfig"
osource "/home/leena/zephyrproject/zephyr/soc/efinix/sapphire/Kconfig"
osource "/home/leena/zephyrproject/zephyr/soc/cdns/xtensa_sample_controller/Kconfig"
osource "/home/leena/zephyrproject/zephyr/soc/cdns/dc233c/Kconfig"
osource "/home/leena/zephyrproject/zephyr/soc/brcm/bcmvk/Kconfig"
osource "/home/leena/zephyrproject/zephyr/soc/brcm/bcm2712/Kconfig"
osource "/home/leena/zephyrproject/zephyr/soc/brcm/bcm2711/Kconfig"
osource "/home/leena/zephyrproject/zephyr/soc/atmel/sam0/Kconfig"
osource "/home/leena/zephyrproject/zephyr/soc/atmel/sam/Kconfig"
osource "/home/leena/zephyrproject/zephyr/soc/aspeed/Kconfig"
osource "/home/leena/zephyrproject/zephyr/soc/arm/Kconfig"
osource "/home/leena/zephyrproject/zephyr/soc/arm/beetle/Kconfig"
osource "/home/leena/zephyrproject/zephyr/soc/andestech/Kconfig"
osource "/home/leena/zephyrproject/zephyr/soc/ambiq/Kconfig"
osource "/home/leena/zephyrproject/zephyr/soc/altr/zephyr_nios2f/Kconfig"
osource "/home/leena/zephyrproject/zephyr/soc/altr/qemu_nios2/Kconfig"
osource "/home/leena/zephyrproject/zephyr/soc/adi/max32/Kconfig"
```
