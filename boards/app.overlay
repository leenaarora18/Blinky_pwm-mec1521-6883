// To get started, press Ctrl+Space to bring up the completion menu and view the available nodes.

// You can also use the buttons in the sidebar to perform actions on nodes.
// Actions currently available include:

// * Enabling / disabling the node
// * Adding the bus to a bus
// * Removing the node
// * Connecting ADC channels

// For more help, browse the DeviceTree documentation at https://docs.zephyrproject.org/latest/guides/dts/index.html
// You can also visit the nRF DeviceTree extension documentation at https://docs.nordicsemi.com/bundle/nrf-connect-vscode/page/guides/ncs_configure_app.html#devicetree-support-in-the-extension
&pwm0 {
    status = "okay";
    //led0_pwm: pwm_led0 
    pwm_led0

    {
       // label = "PWM_LED0";
        PWM_DT_SPEC_GET(DT_ALIAS(pwm_led0))
        pwms = <&pwm0 0 500>;
    };
};

